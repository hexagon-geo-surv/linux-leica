// SPDX-License-Identifier: GPL-2.0-or-later OR MIT
/*
 * Copyright (C) 2023 Leica Geosystems AG
 */

#include "imx8mp-pinfunc.h"

/dts-v1/;
/plugin/;

&uart3 {
	pinctrl-names = "default";
	pinctrl-0 = <&pinctrl_uart3>;
	status = "okay";
};

&iomuxc {
	pinctrl_uart3: uart3grp {
		fsl,pins = <
			MX8MP_IOMUXC_ECSPI1_SCLK__UART3_DCE_RX	0x140
			MX8MP_IOMUXC_ECSPI1_MOSI__UART3_DCE_TX	0x140
		>;
	};
};
