## Documentation/devicetree/bindings/display/imx/fsl,imx8mp-hdmi.yaml
```yaml
# SPDX-License-Identifier: (GPL-2.0-only OR BSD-2-Clause)
%YAML 1.2
---
$id: http://devicetree.org/schemas/display/imx/fsl,imx8mp-hdmi.yaml#
$schema: http://devicetree.org/meta-schemas/core.yaml#

title: Freescale i.MX8MP DWC HDMI TX Encoder

maintainers:
  - Lucas Stach <l.stach@pengutronix.de>

description: |
  The i.MX8MP HDMI transmitter is a Synopsys DesignWare
  HDMI 2.0 TX controller IP.

allOf:
  - $ref: ../bridge/synopsys,dw-hdmi.yaml#

properties:
  compatible:
    enum:
      - fsl,imx8mp-hdmi

  reg-io-width:
    const: 1

  clocks:
    maxItems: 5

  clock-names:
    items:
      - const: iahb
      - const: isfr
      - const: fdcc
      - const: cec
      - const: pix

  power-domains:
    maxItems: 1

required:
  - compatible
  - reg
  - clocks
  - clock-names
  - interrupts
  - power-domains

unevaluatedProperties: false

examples:
  - |
    #include <dt-bindings/interrupt-controller/irq.h>
    #include <dt-bindings/clock/imx8mp-clock.h>
    #include <dt-bindings/power/imx8mp-power.h>

    hdmi@32fd8000 {
        compatible = "fsl,imx8mp-hdmi";
        reg = <0x32fd8000 0x7eff>;
        interrupts = <0 IRQ_TYPE_LEVEL_HIGH>;
        clocks = <&clk IMX8MP_CLK_HDMI_APB>,
                 <&clk IMX8MP_CLK_HDMI_REF_266M>,
                 <&clk IMX8MP_CLK_HDMI_FDCC_TST>,
                 <&clk IMX8MP_CLK_32K>,
                 <&hdmi_tx_phy>;
        clock-names = "iahb", "isfr", "fdcc", "cec", "pix";
        power-domains = <&hdmi_blk_ctrl IMX8MP_HDMIBLK_PD_HDMI_TX>;
        reg-io-width = <1>;
    };
```

## Documentation/devicetree/bindings/fpga/altera-hps2fpga-bridge.txt
```
Altera FPGA/HPS Bridge Driver

Required properties:
- compatible	: Should contain one of:
		  "altr,socfpga-lwhps2fpga-bridge",
		  "altr,socfpga-hps2fpga-bridge", or
		  "altr,socfpga-fpga2hps-bridge"
- reset-names	: Should contain one of:
		  "lwhps2fpga",
		  "hps2fpga", or
		  "fpga2hps"
- resets	: Phandle and reset specifier for the reset listed in
		  reset-names
- clocks	: Clocks used by this module.

Optional properties:
- bridge-enable	: 0 if driver should disable bridge at startup.
		  1 if driver should enable bridge at startup.
		  Default is to leave bridge in its current state.

Example:
	hps_fpgabridge0: fpgabridge@0 {
		compatible = "altr,socfpga-lwhps2fpga-bridge";
		resets = <&rst LWHPS2FPGA_RESET>;
		reset-names = "lwhps2fpga";
		clocks = <&l4_main_clk>;
		bridge-enable = <0>;
	};

	hps_fpgabridge1: fpgabridge@1 {
		compatible = "altr,socfpga-hps2fpga-bridge";
		resets = <&rst HPS2FPGA_RESET>;
		reset-names = "hps2fpga";
		clocks = <&l4_main_clk>;
		bridge-enable = <1>;
	};

	hps_fpgabridge2: fpgabridge@2 {
		compatible = "altr,socfpga-fpga2hps-bridge";
		resets = <&rst FPGA2HPS_RESET>;
		reset-names = "fpga2hps";
		clocks = <&l4_main_clk>;
	};
```

## Documentation/devicetree/bindings/fpga/fpga-area.txt
```
FPGA Area
=========

A FPGA Area details information about a section of an FPGA including the FPGA
image needed to program it and the hardware contained in this section of the
FPGA once it is programmed.

A FPGA Area corresponds to the whole FPGA in the case of full reconfiguration
or a section of a FPGA in the case of partial reconfiguration.

Required properties:
- compatible : should contain "fpga-area"
- #address-cells, #size-cells, ranges: must be present to handle address space
  mapping for children.

Optional properties:
- firmware-name : should contain the name of a FPGA image file located on the
  firmware search path.
- partial-reconfig : boolean property should be defined if partial
  reconfiguration of the FPGA is to be done, otherwise full reconfiguration
  is done.

Example:

/dts-v1/;
/plugin/;
/ {
	fragment@0 {
		target-path="/soc/fpgamgr@0/bridge@0";
		__overlay__ {
			#address-cells = <1>;
	                #size-cells = <1>;

			bridge@ff200000 {
				compatible = "fpga-area";

				#address-cells = <2>;
				#size-cells = <1>;

				ranges = <0 0x00000000 0xc0000000 0x00010000>,
					 <1 0x00020000 0xff220000 0x00000008>,
					 <1 0x00010040 0xff210040 0x00000020>;

				firmware-name = "soc_system.rbf";

				onchip_memory2_0: memory@000000000 {
					device_type = "memory";
					compatible = "altr,onchipmem-15.1";
					reg = <0 0x00000000 0x00010000>;
				};

				jtag_uart: serial@100020000 {
					compatible = "altr,juart-1.0";
					reg = <1 0x00020000 0x00000008>;
					interrupt-parent = <&intc>;
					interrupts = <0 42 4>;
				};

				led_pio: gpio@100010040 {
					compatible = "altr,pio-1.0";
					reg = <1 0x00010040 0x00000020>;
					altr,gpio-bank-width = <4>;
					#gpio-cells = <2>;
					gpio-controller;
				};
			};
		};
	};
};
```

## Documentation/devicetree/bindings/input/touchscreen/touchnetix,ax54a.yaml
```yaml
# SPDX-License-Identifier: (GPL-2.0-only OR BSD-2-Clause)
%YAML 1.2
---
$id: http://devicetree.org/schemas/input/touchscreen/touchnetix,ax54a.yaml#
$schema: http://devicetree.org/meta-schemas/core.yaml#

title: TouchNetix Axiom series touchscreen controller

maintainers:
  - Marco Felsch <kernel@pengutronix.de>

allOf:
  - $ref: /schemas/input/touchscreen/touchscreen.yaml#
  - $ref: /schemas/input/input.yaml#

properties:
  compatible:
    const: touchnetix,ax54a

  reg:
    enum: [ 0x66, 0x67 ]

  interrupts:
    maxItems: 1

  reset-gpios:
    maxItems: 1

  vdda-supply:
    description: Analog power supply regulator on VDDA pin

  vddi-supply:
    description: I/O power supply regulator on VDDI pin

required:
  - compatible
  - reg
  - vdda-supply
  - vddi-supply

unevaluatedProperties: false

examples:
  - |
    #include <dt-bindings/gpio/gpio.h>
    #include <dt-bindings/interrupt-controller/arm-gic.h>
    i2c {
      #address-cells = <1>;
      #size-cells = <0>;

      touchscreen@66 {
        compatible = "touchnetix,ax54a";
        reg = <0x66>;
        interrupt-parent = <&gpio2>;
        interrupts = <2 IRQ_TYPE_EDGE_FALLING>;
        reset-gpios = <&gpio1 1 GPIO_ACTIVE_HIGH>;
        vdda-supply = <&vdda_reg>;
        vddi-supply = <&vddi_reg>;
        poll-interval = <20>;
      };
    };
...
```

## Documentation/devicetree/bindings/media/i2c/sony,imx283.yaml
```yaml
# SPDX-License-Identifier: (GPL-2.0-only OR BSD-2-Clause)
# Copyright (C) 2024 Ideas on Board Oy
%YAML 1.2
---
$id: http://devicetree.org/schemas/media/i2c/sony,imx283.yaml#
$schema: http://devicetree.org/meta-schemas/core.yaml#

title: Sony IMX283 Sensor

maintainers:
  - Kieran Bingham <kieran.bingham@ideasonboard.com>
  - Umang Jain <umang.jain@ideasonboard.com>

description:
  IMX283 sensor is a Sony CMOS active pixel digital image sensor with an active
  array size of 5472H x 3648V. It is programmable through I2C interface. The
  I2C client address is fixed to 0x1a as per sensor data sheet. Image data is
  sent through MIPI CSI-2.

properties:
  compatible:
    const: sony,imx283
  reg:
    description: I2C address
    maxItems: 1

  assigned-clocks: true
  assigned-clock-parents: true
  assigned-clock-rates: true

  clocks:
    description: Clock frequency from 6 to 24 MHz.
    maxItems: 1

  vadd-supply:
    description: Analog power supply (2.9V)

  vdd1-supply:
    description: Interface power supply (1.8V)

  vdd2-supply:
    description: Digital power supply (1.2V)

  port:
    additionalProperties: false
    $ref: /schemas/graph.yaml#/$defs/port-base

    properties:
      endpoint:
        $ref: /schemas/media/video-interfaces.yaml#
        unevaluatedProperties: false

        properties:
          data-lanes: true
          link-frequencies: true

        required:
          - data-lanes
          - link-frequencies

    required:
      - endpoint

required:
  - compatible
  - reg
  - clocks
  - port

additionalProperties: false

examples:
  - |
    i2c {
        #address-cells = <1>;
        #size-cells = <0>;

        camera@1a {
            compatible = "sony,imx283";
            reg = <0x1a>;
            clocks = <&imx283_clk>;

            assigned-clocks = <&imx283_clk>;
            assigned-clock-parents = <&imx283_clk_parent>;
            assigned-clock-rates = <12000000>;

            vadd-supply = <&camera_vadd_2v9>;
            vdd1-supply = <&camera_vdd1_1v8>;
            vdd2-supply = <&camera_vdd2_1v2>;

            port {
                imx283: endpoint {
                    remote-endpoint = <&cam>;
                    data-lanes = <1 2 3 4>;
                    link-frequencies = /bits/ 64 <360000000>;
                };
            };
        };
    };
...
```

## Documentation/devicetree/bindings/misc/uboot-bootcount.txt
```
U-Boot bootcount driver

This driver implements the Linux kernel half of the boot count feature -
the boot counter can only be reset after it is clear that the
application has been started and is running correctly, which usually
can only be determined by the application code itself. Thus the reset
of the boot counter must be done by application code, which thus needs
an appropriate driver.

Required feature by the Carrier Grade Linux Requirements Definition;
see for example document "Carrier Grade Linux Requirements Definition
Overview V3.0" at

http://www.linuxfoundation.org/collaborate/workgroups/cgl/requirements#SMM.6.0_Boot_Cycle_Detection

        Description: OSDL CGL specifies that carrier grade Linux
        shall provide support for detecting a repeating reboot cycle
        due to recurring failures. This detection should happen in
        user space before system services are started.

This driver provides read/write access to the U-Boot bootcounter
through sysFS file.

Currently memory type only supported.

Required properties:

  - compatible : should be "uboot,bootcount"
  - reg: the address of the bootcounter

Example:

bootcount@1c23000 {
	compatible = "uboot,bootcount";
	reg = <0x23060 0x20>;
};
```

## Documentation/devicetree/bindings/mmc/sdhci-pltfm.txt
```
Generic SHDCI platform driver

The generic SDHCI platform driver should support most SDHCI host
controllers. It uses the compatible="generic-sdhci" property and
supports the following device tree properties as described in mmc.txt.

Supported properties (described in mmc.txt):
- reg
- interrupts
- wp-inverted
- broken-cd
- no-1-8-v
- keep-power-in-suspend
- enable-sdio-wakeup
- bus-width
- clock-frequency
```

## Documentation/devicetree/bindings/mtd/altera,quadspi.yaml
```yaml
# SPDX-License-Identifier: (GPL-2.0-only OR BSD-2-Clause)
%YAML 1.2
---
$id:  http://devicetree.org/schemas/mtd/altera,quadspi.yaml#
$schema: http://devicetree.org/meta-schemas/core.yaml#

title: Intel FPGA Generic QUAD SPI Controller (Version 1) Device Tree Bindings

allOf:
  - $ref: "nand-controller.yaml"

maintainers:
  - Andrey Zhizhikin <andrey.z@gmail.com>

description: |
  This SPI Controller covers only Version 1 of the SoftIP, which can be
  instantiated in FPGA fabric. It is used to read and program
  Configuration Devices, and is not JEDEC-compliant. Individual flash
  devices should be present as tree subnode.

properties:
  "#address-cells": true
  "#size-cells": true

  compatible:
    items:
      - const: altr,quadspi-1.0

  reg:
    items:
      - description: register configuration base address
      - description: data base address

  reg-names:
    items:
      - const: avl_csr
      - const: avl_mem

required:
  - compatible
  - reg

unevaluatedProperties: false

examples:
  - |
    QspiCtrl0: quadspi@0xc0040000 {
      compatible = "altr,quadspi-1.0";
      reg = <0xc0040000 0x20>, <0xc4000000 0x04000000>;
      reg-names = "avl_csr", "avl_mem";
      #address-cells = <1>;
      #size-cells = <0>;
      flash0: epcq512@0 {
        compatible = "epcq512";
        reg = < 0x0 >;
        #address-cells = <1>;
        #size-cells = <1>;
        partition@0 {
          label = "FPGA image";
          reg = <0x0 0x04000000>;
        };
      };
    };
```

## Documentation/devicetree/bindings/soc/socfpga/altr,l3-nic.txt
```
Altera SOCFPGA L3 Network Interconnect
--------------------------------------

The L3 NIC provides access to Global Programmer View (GPV) registers for all
AXI slaves and masters on the SoC.

Required properties:
- compatible : "altr,l3-nic"
- reg : Should contain 1 register range (address and length)

Example:
	 gpv@ff800000 {
		compatible = "altr,l3-nic";
		reg = <0xff800000 0x100000>;
	};
```
