## Documentation/devicetree/bindings/iio/proximity/semtech,sx9370.yaml
```yaml
# SPDX-License-Identifier: (GPL-2.0 OR BSD-2-Clause)
# SPDX-FileCopyrightText: 2018 Semtech Corp
%YAML 1.2
---
$id: http://devicetree.org/schemas/iio/proximity/semtech,sx9370.yaml#
$schema: http://devicetree.org/meta-schemas/core.yaml#

title: Semtech SX9370 capacitive proximity sensor

description: |
  Semtech SX9370 capacitive SAR (Specific Absorption Rate) proximity sensor
  with 8 configurable channels and advanced proximity detection capabilities.
  Features configurable thresholds, smart sensing engines, and real-time
  proximity event detection. Commonly used in mobile devices for human body
  proximity detection to enable dynamic RF power reduction and ensure
  electromagnetic radiation compliance.

properties:
  compatible:
    const: semtech,sx9370

  reg:
    maxItems: 1
    description:
      I2C slave address of the device.

  interrupts:
    maxItems: 1
    description:
      Interrupt generated by the device when proximity events occur,
      conversion is complete, or when smart sensing engines detect
      human body presence. Supports level-triggered interrupts.

  vdd-supply:
    description:
      Main power supply regulator (typically 1.8V to 3.6V).
      Required for device operation and I2C communication.

  dpr-gpios:
    maxItems: 1
    description: |
      Dynamic Power Reduction (DPR) control GPIO.
      Asserted when human body proximity is detected via threshold
      triggers or smart sensing engines, enabling dynamic RF power
      reduction for electromagnetic compliance and power optimization.
      Can be used to control external RF circuits or notify the
      system for power management decisions.

additionalProperties: false

required:
  - compatible
  - reg
  - interrupts

allOf:
  - $ref: /schemas/iio/iio.yaml#

examples:
  - |
    #include <dt-bindings/interrupt-controller/irq.h>
    #include <dt-bindings/gpio/gpio.h>

    i2c {
        #address-cells = <1>;
        #size-cells = <0>;

        proximity@2c {
            compatible = "semtech,sx9370";
            reg = <0x2c>;
            interrupt-parent = <&gpio1>;
            interrupts = <17 IRQ_TYPE_LEVEL_LOW>;
            vdd-supply = <&ldo_sensor_3v3>;
            dpr-gpios = <&gpio0 15 GPIO_ACTIVE_HIGH>;
        };
    };

  - |
    #include <dt-bindings/interrupt-controller/irq.h>

    i2c {
        #address-cells = <1>;
        #size-cells = <0>;

        proximity@28 {
            compatible = "semtech,sx9370";
            reg = <0x28>;
            interrupt-parent = <&gpio2>;
            interrupts = <23 IRQ_TYPE_EDGE_FALLING>;
        };
    };
```
