// SPDX-License-Identifier: (GPL-2.0+ OR MIT)
/*
 * Copyright (C) 2021 Leica Geosystems AG
 */

/dts-v1/;

#include "imx8mm-leica-crocodile.dtsi"
#include "imx8mm-leica-crocodile-rpmsg.dtsi"

/ {
	model = "Crocodile-Rev-B-rwk";
};

&fec1 {
	/*
	 * disable reset gpio since PHY is not detected anymore after a reset.
	 */
	/delete-property/ phy-reset-gpios;
	/delete-property/ phy-reset-duration;
};

&iomuxc {
	pinctrl_gpio: gpiogrp {
		fsl,pins = <
			MX8MM_IOMUXC_SAI5_RXC_GPIO3_IO20		0x00	/*CROCODILE_LTE_ONX*/
			MX8MM_IOMUXC_SD2_WP_GPIO2_IO20		0x00	/*CROCODILE_LTE_EMERG_RST*/
			MX8MM_IOMUXC_SAI5_MCLK_GPIO3_IO25		0x20	/*CROCODILE_LTE_FST_SHDN*/
			MX8MM_IOMUXC_SAI5_RXFS_GPIO3_IO19		0x00	/*CROCODILE_GNSS_RSTX*/
			MX8MM_IOMUXC_SAI5_RXD0_GPIO3_IO21		0x00	/*CROCODILE_GNSS_EXTINT*/
			MX8MM_IOMUXC_SAI5_RXD1_GPIO3_IO22		0x00	/*CROCODILE_UHF_SDN*/
			MX8MM_IOMUXC_SAI5_RXD2_GPIO3_IO23		0x100	/*CROCODILE_UHF_GPIO_0*/
			MX8MM_IOMUXC_GPIO1_IO01_GPIO1_IO1	0x00	/*CROCODILE_WIFIBT_PWR_DOWN*/
			MX8MM_IOMUXC_GPIO1_IO13_GPIO1_IO13	0x00	/*CROCODILE_IMX8_USB1_OC_SOURCEx*/
			MX8MM_IOMUXC_GPIO1_IO15_GPIO1_IO15	0x00	/*CROCODILE_IMX8_USB1_OC_SINKx*/
			MX8MM_IOMUXC_GPIO1_IO10_GPIO1_IO10		0x100	/*CROCODILE_IMX8_CPU_RDY*/
			
			/* Set reworked pads */
			MX8MM_IOMUXC_GPIO1_IO05_GPIO1_IO5	0x20
			MX8MM_IOMUXC_GPIO1_IO11_GPIO1_IO11	0x20
			MX8MM_IOMUXC_GPIO1_IO12_GPIO1_IO12	0x00
			MX8MM_IOMUXC_GPIO1_IO14_GPIO1_IO14	0x00
			MX8MM_IOMUXC_SAI2_TXFS_GPIO4_IO24	0x20
		>;
	};
};
