## arch/arm/configs/krea_defconfig
```kconfig
CONFIG_ALTERA_FREEZE_BRIDGE=y
CONFIG_ALTERA_ILC=y
CONFIG_ALTERA_SYSID=y
CONFIG_ARCH_INTEL_SOCFPGA=y
CONFIG_ARM_THUMBEE=y
CONFIG_AUTOFS4_FS=y
CONFIG_BLK_DEV_INITRD=y
CONFIG_BLK_DEV_LOOP=y
CONFIG_BLK_DEV_RAM_COUNT=2
CONFIG_BLK_DEV_RAM_SIZE=8192
CONFIG_BLK_DEV_RAM=y
CONFIG_BMP280=y
CONFIG_CGROUPS=y
CONFIG_CMA_DEBUGFS=y
CONFIG_CMA_SYSFS=y
CONFIG_CMA=y
CONFIG_CPUSETS=y
CONFIG_DEBUG_FS=y
CONFIG_DEBUG_INFO=y
CONFIG_DEBUG_USER=y
CONFIG_DETECT_HUNG_TASK=y
CONFIG_DEVTMPFS_MOUNT=y
CONFIG_DEVTMPFS=y
CONFIG_DMA_API_DEBUG=y
CONFIG_DMABUF_HEAPS_CMA=y
CONFIG_DMABUF_HEAPS_SYSTEM=y
CONFIG_DMABUF_HEAPS=y
CONFIG_DMABUF_SYSFS_STATS=y
CONFIG_DMA_CMA=y
CONFIG_DMADEVICES=y
CONFIG_DMATEST=y
# CONFIG_DVB_DYNAMIC_MINORS is not set
# CONFIG_DVB_NET is not set
CONFIG_DW_WATCHDOG=y
CONFIG_EEPROM_AT24=y
CONFIG_EMBEDDED=y
CONFIG_EXT2_FS_POSIX_ACL=y
CONFIG_EXT2_FS_XATTR=y
CONFIG_EXT2_FS=y
CONFIG_EXT3_FS=y
CONFIG_EXTCON=y
CONFIG_FPGA_BRIDGE=y
CONFIG_FPGA_MGR_SOCFPGA_A10=y
CONFIG_FPGA_MGR_SOCFPGA=y
CONFIG_FPGA_REGION=y
CONFIG_FPGA=y
CONFIG_FUNCTION_TRACER=y
CONFIG_GPIO_ALTERA_A10SR=y
CONFIG_GPIO_ALTERA=y
CONFIG_GPIO_DWAPB=y
CONFIG_GPIOLIB=y
CONFIG_GPIO_SYSFS=y
CONFIG_HIGHMEM=y
CONFIG_HIGH_RES_TIMERS=y
CONFIG_I2C_CHARDEV=y
CONFIG_I2C_DESIGNWARE_PLATFORM=y
CONFIG_I2C_OCORES=y
CONFIG_I2C=y
CONFIG_IIO=y
CONFIG_IKCONFIG_PROC=y
CONFIG_IKCONFIG=y
CONFIG_INET=y
CONFIG_INPUT_EVDEV=y
CONFIG_IP_MULTICAST=y
CONFIG_IP_PNP_BOOTP=y
CONFIG_IP_PNP_DHCP=y
CONFIG_IP_PNP_RARP=y
CONFIG_IP_PNP=y
CONFIG_JFFS2_FS=y
CONFIG_LEDS_BLINKM=y
CONFIG_LEDS_CLASS=y
CONFIG_LEDS_SYSCON=y
CONFIG_LEDS_TLC591XX=y
CONFIG_LEGACY_PTY_COUNT=16
CONFIG_LOG_BUF_SHIFT=14
CONFIG_LTC2497=y
CONFIG_MAGIC_SYSRQ=y
# CONFIG_MEDIA_CEC_SUPPORT is not set
CONFIG_MEDIA_SUPPORT=y
CONFIG_MFD_ALTERA_A10SR=y
CONFIG_MFD_ALTERA_SYSMGR=y
CONFIG_MFD_STMPE=y
CONFIG_MICREL_PHY=y
CONFIG_MMC_DW=y
CONFIG_MMC=y
CONFIG_MODULES=y
CONFIG_MODULE_UNLOAD=y
CONFIG_MTD_BLOCK=y
CONFIG_MTD_CMDLINE_PARTS=y
CONFIG_MTD_NAND_DENALI_DT=y
CONFIG_MTD_RAW_NAND=y
# CONFIG_MTD_SPI_NOR_USE_4K_SECTORS is not set
CONFIG_MTD_SPI_NOR=y
CONFIG_MTD=y
CONFIG_NAMESPACES=y
CONFIG_NEON=y
CONFIG_NETDEVICES=y
CONFIG_NET_KEY_MIGRATE=y
CONFIG_NET_KEY=y
CONFIG_NETWORK_PHY_TIMESTAMPING=y
CONFIG_NET=y
CONFIG_NEW_LEDS=y
CONFIG_NFSD_V3_ACL=y
CONFIG_NFSD_V4=y
CONFIG_NFSD=y
CONFIG_NFS_FS=y
CONFIG_NFS_V3_ACL=y
CONFIG_NFS_V4=y
CONFIG_NLS_CODEPAGE_437=y
CONFIG_NLS_ISO8859_1=y
CONFIG_NR_CPUS=2
CONFIG_NTFS_FS=y
CONFIG_NTFS_RW=y
CONFIG_OF_CONFIGFS=y
CONFIG_OF_FPGA_REGION=y
CONFIG_OF_OVERLAY=y
CONFIG_PACKET=y
CONFIG_PCIE_ALTERA_MSI=y
CONFIG_PCIE_ALTERA=y
CONFIG_PCI_MSI=y
CONFIG_PCI=y
CONFIG_PL330_DMA=y
CONFIG_PMBUS=y
CONFIG_PREEMPT_RT=y
CONFIG_PRINTK_TIME=y
CONFIG_PROFILING=y
# CONFIG_RADIO_ADAPTERS is not set
CONFIG_REGULATOR_FIXED_VOLTAGE=y
CONFIG_REGULATOR=y
CONFIG_ROOT_NFS=y
CONFIG_RTC_CLASS=y
CONFIG_RTC_DRV_DS1307=y
# CONFIG_SCHED_DEBUG is not set
CONFIG_SENSORS_ALTERA_A10SR=y
CONFIG_SENSORS_JC42=y
CONFIG_SENSORS_LTC2978_REGULATOR=y
CONFIG_SENSORS_LTC2978=y
CONFIG_SENSORS_MAX1619=y
CONFIG_SENSORS_TMP102=y
CONFIG_SERIAL_8250_CONSOLE=y
CONFIG_SERIAL_8250_DW=y
CONFIG_SERIAL_8250_NR_UARTS=2
CONFIG_SERIAL_8250_RUNTIME_UARTS=2
CONFIG_SERIAL_8250=y
CONFIG_SERIAL_ALTERA_UART=y
CONFIG_SERIO_AMBAKMI=y
# CONFIG_SERIO_SERPORT is not set
CONFIG_SMP=y
CONFIG_SOCFPGA_FPGA_BRIDGE=y
CONFIG_SPI_ALTERA_QSPI=y
CONFIG_SPI_ALTERA=y
CONFIG_SPI_BITBANG=y
CONFIG_SPI_CADENCE_QUADSPI=y
CONFIG_SPI_DESIGNWARE=y
CONFIG_SPI_DW_MMIO=y
CONFIG_SPI_SPIDEV=y
CONFIG_SPI=y
CONFIG_SRAM=y
CONFIG_STMMAC_ETH=y
CONFIG_SYSVIPC=y
CONFIG_TMPFS=y
CONFIG_UIO_PDRV_GENIRQ=y
CONFIG_UIO=y
CONFIG_UNIX=y
# CONFIG_USB_SUPPORT is not set
CONFIG_VFAT_FS=y
CONFIG_VFP=y
CONFIG_VLAN_8021Q_GVRP=y
CONFIG_VLAN_8021Q=y
CONFIG_VT_HW_CONSOLE_BINDING=y
CONFIG_WATCHDOG=y
# CONFIG_WIRELESS is not set
# CONFIG_WLAN is not set
```
