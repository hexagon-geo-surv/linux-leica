// SPDX-License-Identifier: (GPL-2.0+ OR MIT)
/*
 * Copyright (C) 2021 Leica Geosystems AG
 */

/dts-v1/;

#include "crocodile.dtsi"

/ {
	model = "Crocodile-PT1";
};

&fec1 {
	/*
	 * disable reset gpio since PHY is not detected anymore after a reset.
	 */
	/delete-property/ phy-reset-gpios;
	/delete-property/ phy-reset-duration;
};
